## config/west.yml
```yaml
manifest:
  remotes:
    - name: zmkfirmware
      url-base: https://github.com/zmkfirmware
    - name: Reinmuth66
      url-base: https://github.com/Reinmuth66
    - name: kot149
      url-base: https://github.com/kot149
    - name: jjggzhou
      url-base: https://github.com/jjggzhou
  projects:
    - name: zmk
      remote: zmkfirmware
      revision: main
      import: app/west.yml
    - name: zmk-rgbled-widget
      remote: Reinmuth66
      revision: main
    - name: zmk-analog-input-driver
      remote: jjggzhou
      revision: main
    - name: zmk-mouse-gesture
      remote: kot149
      revision: v1
  self:
    path: config
```
